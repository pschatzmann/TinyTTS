/**
 * TinyTTS -> I2S (arduino-audio-tools) on ESP32-S3.
 *
 * TinyTTS does not embed or auto-include a model itself -- the data headers
 * below (generated by research/export_headers.py, see docs/research.md) are
 * example/reference model data shipped with the library for convenience,
 * but only used if a sketch explicitly includes them and wires them in via
 * setters before begin(), as done here. No PROGMEM macro needed: unlike
 * AVR, ESP32's toolchain places `const` data in flash automatically.
 *
 * This uses the slimmed CMU dictionary (default_cmudict_slim) plus the
 * neural G2P fallback model (default_dictionary_model) instead of the full
 * dictionary (default_cmudict, the one TinyTTS/Data.h's umbrella include
 * pulls in) -- together they're actually *smaller* than the full dictionary
 * alone and give better pronunciation for words the dictionary doesn't
 * cover, now that the model's own GRU weight matrices are INT8-quantized.
 * See README.md's "Model data sizes" for the full breakdown and why this
 * wasn't always the better option (it wasn't, before that quantization).
 * Since these two aren't part of TinyTTS/Data.h's umbrella (the slim
 * dictionary REQUIRES the model to also be wired in, so bundling either
 * with the always-safe default two wouldn't make sense), each data header
 * is included individually below instead of via TinyTTS/Data.h. There's no
 * separate duration_predictor or vocoder data header at all -- every model
 * stage is hand-written C++ (DurationPredictor.h/Vocoder.h), all their
 * weights are part of default_weights.
 *
 * This much embedded data is larger than any predefined board partition
 * scheme offers as an app partition, hence the custom partitions.csv
 * alongside this sketch. See README.md's Requirements section for the
 * per-file sizes and a table of which ESP32-S3 module flash/PSRAM sizes
 * this fits -- if yours doesn't, use the File-based setter overloads
 * (tts.setWeights(File&), etc.) to load from LittleFS/FFat/SD instead of
 * compiling the data into flash.
 *
 * Board settings used for this example: PSRAM=opi, FlashSize=16M,
 * PartitionScheme=custom (uses partitions.csv), USBMode=hwcdc,
 * CDCOnBoot=cdc (required for native-USB Serial to work at all on this
 * board).
 */
#include "TinyTTS.h"
#include "TinyTTS/data/default_weights_data.h"
#include "TinyTTS/data/default_cmudict_slim_data.h"
#include "TinyTTS/data/default_dictionary_model_data.h"

#include "AudioTools.h"
#include "AudioTools/AudioLibs/I2SCodecStream.h"

// I2SStream alone drives only the raw I2S clock/data lines -- boards with an
// actual audio codec chip (like this one: ES8311 codec + FM8002E speaker
// amp) need the codec's own I2C setup (mute/unmute, gain, power) done too,
// or there's no sound. I2SCodecStream does both via the board profile (see
// https://github.com/pschatzmann/arduino-audio-driver).
I2SCodecStream i2s_out(ESP32S3HosyondDisplay);
TinyTTS tts(i2s_out);

void setup() {
  Serial.begin(115200);
  while (!Serial) {}
  delay(2000);

  Serial.printf("PSRAM: %u bytes free of %u\n", ESP.getFreePsram(), ESP.getPsramSize());

  // Setup I2s
  auto cfg = i2s_out.defaultConfig(TX_MODE);
  cfg.sample_rate = tts.getAudioSampleRate();
  cfg.channels = tts.getAudioChannels();
  cfg.bits_per_sample = tts.getAudioBitsPerSample();
  i2s_out.begin(cfg);

  // setup TTS
  tts.setWeights(default_weights, default_weights_len);
  tts.setDictionary(default_cmudict_slim, default_cmudict_slim_len);
  tts.setDictionaryModel(default_dictionary_model, default_dictionary_model_len);
  if (!tts.begin()) {
    Serial.println("TinyTTS.begin() failed -- did you call all setters above?");
    while (true) {}
  }

  Serial.printf("PSRAM after begin(): %u bytes free of %u\n", ESP.getFreePsram(), ESP.getPsramSize());
  Serial.println("Ready.");
  uint32_t t0 = millis();
  bool ok = tts.speak("Hello world!");
  Serial.printf("speak() returned %d after %lu ms, PSRAM free: %u\n", ok, millis() - t0, ESP.getFreePsram());
}

void loop() {
  uint32_t t0 = millis();
  bool ok = tts.speak("Hello world!");
  Serial.printf("speak() returned %d after %lu ms, PSRAM free: %u\n", ok, millis() - t0, ESP.getFreePsram());
  delay(5000);
}
